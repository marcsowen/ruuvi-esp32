## main/Kconfig.projbuild
```kconfig
menu "Ruuvi-esp32 specific config"

    config RUUVI_ESP32_WIFI_SSID
      string "WiFi SSID"

    config RUUVI_ESP32_WIFI_PASSWORD
      string "WiFi Password"

endmenu
```
